## build/conf/bblayers.conf
```bitbake
# POKY_BBLAYERS_CONF_VERSION is increased each time build/conf/bblayers.conf
# changes incompatibly
POKY_BBLAYERS_CONF_VERSION = "2"

BBPATH = "${TOPDIR}"
BBFILES ?= ""

BBLAYERS ?= " \
  /home/xuning/poky-bbb-board/poky/meta \
  /home/xuning/poky-bbb-board/poky/meta-poky \
  /home/xuning/poky-bbb-board/poky/meta-yocto-bsp \
  /home/xuning/poky-bbb-board/meta-openembedded/meta-oe \
  /home/xuning/poky-bbb-board/meta-openembedded/meta-networking \
  /home/xuning/poky-bbb-board/meta-openembedded/meta-python \
  /home/xuning/poky-bbb-board/meta-security \
  /home/xuning/poky-bbb-board/meta-qt6 \
  /home/xuning/poky-bbb-board/meta-bbb \
  /home/xuning/poky-bbb-board/meta-custom \
  "
```

## meta-custom/conf/local.conf.sample
```bitbake
# Local configuration for AM3359 custom board
# Yocto Project 5.2 Poky distribution [walnascar] branch

DISTRO_FEATURES = "ext2 security systemd usbhost ${DISTRO_FEATURES_LIBC}"

DISTRO_FEATURES_BACKFILL_CONSIDERED += "pulseaudio sysvinit"

DISTRO_FEATURES:remove = "ptest"

INIT_MANAGER = "systemd"

# 使用AM3359机器配置
MACHINE = "am3359"

# 根据您的板子修改设备树文件
# 如果使用标准BeagleBone设备树，可以使用：
# KERNEL_DTB = "am335x-boneblack.dtb"
# 如果需要自定义设备树，请指定您的设备树文件名
KERNEL_DTB = "am335x-boneblack.dtb"

# SD卡启动配置
# 构建最小镜像用于SD卡启动
# bitbake core-image-minimal-sdcard

PREFERRED_PROVIDER_virtual/kernel = "linux-stable"

#DL_DIR = "/src/walnascar"
#SSTATE_DIR = "/oe5/bbb/sstate-cache"
#TMPDIR = "/oe5/bbb/tmp"

DISTRO = "poky"
PACKAGE_CLASSES = "package_ipk"

SDKMACHINE = "x86_64"

EXTRA_IMAGE_FEATURES = "empty-root-password allow-empty-password allow-root-login"

PATCHRESOLVE = "noop"
RM_OLD_IMAGE = "1"
INHERIT += "rm_work"
CONF_VERSION = "2"
```

## meta-custom/conf/machine/am3359.conf
```bitbake
#@TYPE: Machine
#@NAME: AM3359 Custom Board
#@DESCRIPTION: Machine configuration for custom board with AM3359 SOC

# 继承基础配置，基于am335x系列
SOC_FAMILY = "ti335x"
TARGET_ARCH = "arm"

DEFAULTTUNE ?= "cortexa8hf-neon"
require conf/machine/include/arm/armv7a/tune-cortexa8.inc

PREFERRED_PROVIDER_virtual/kernel = "linux-stable"
KERNEL_IMAGETYPE = "zImage"

PREFERRED_PROVIDER_virtual/bootloader = "u-boot"
PREFERRED_PROVIDER_u-boot = "u-boot"
SPL_BINARY = "MLO"
UBOOT_SUFFIX = "img"
# 如果使用标准am335x配置，保持这个；如果需要定制，可以修改
UBOOT_MACHINE = "am335x_evm_config"

EXTRA_IMAGEDEPENDS += "u-boot u-boot-scr"

SERIAL_CONSOLES = "115200;ttyS0 115200;ttyO0 115200;ttyAMA0"

# SD卡启动支持：生成ext2/ext3文件系统镜像和wic完整镜像
IMAGE_FSTYPES = "tar.gz ext2 ext3 wic"
# 如果需要压缩的ext2镜像（更小）
# IMAGE_FSTYPES = "tar.gz ext2.gz ext3"

MACHINE_ESSENTIAL_EXTRA_RDEPENDS = "kernel-image kernel-devicetree kernel-modules"

MACHINE_FEATURES = "ext2 serial usbhost vfat"

# WIC镜像启动文件配置
# 定义设备树文件列表（从KERNEL_DEVICETREE中提取文件名）
# KERNEL_DEVICETREE格式：ti/omap/am335x-boneblack.dtb ti/omap/am335x-bonegreen.dtb ...
DTB_FILES = "am335x-boneblack.dtb am335x-boneblack-wireless.dtb am335x-boneblue.dtb am335x-bonegreen.dtb am335x-bonegreen-wireless.dtb am335x-pocketbeagle.dtb bbb-gen4-4dcape70t.dtb"
IMAGE_BOOT_FILES ?= "u-boot.${UBOOT_SUFFIX} ${SPL_BINARY} ${KERNEL_IMAGETYPE} ${DTB_FILES} boot.scr"

# 注意：如果您的板子需要特定的设备树文件，请在local.conf中设置KERNEL_DTB
# 例如：KERNEL_DTB = "am335x-your-board.dtb"
```
